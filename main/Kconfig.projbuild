## main/Kconfig.projbuild
```kconfig
menu "Tension Controller Configuration"

    menu "GPIO Pin Assignments"
        config ENCODER_GPIO_A
            int "Encoder Channel A GPIO"
            default 4
            help
                GPIO pin for encoder channel A (PCNT capable)

        config ENCODER_GPIO_B
            int "Encoder Channel B GPIO"
            default 5
            help
                GPIO pin for encoder channel B (PCNT capable)

        config HX711_GPIO_DATA
            int "HX711 Data GPIO"
            default 13
            help
                GPIO pin for HX711 data line (DOUT)

        config HX711_GPIO_CLOCK
            int "HX711 Clock GPIO"
            default 14
            help
                GPIO pin for HX711 clock line (SCK)

        config MOTOR_GPIO_PWM
            int "Motor PWM GPIO"
            default 15
            help
                GPIO pin for motor PWM output (LEDC capable)

        config MOTOR_GPIO_DIR
            int "Motor Direction GPIO"
            default 16
            help
                GPIO pin for motor direction control

        config LCD_GPIO_SDA
            int "LCD I2C SDA GPIO"
            default 8
            help
                GPIO pin for I2C data line

        config LCD_GPIO_SCL
            int "LCD I2C SCL GPIO"
            default 9
            help
                GPIO pin for I2C clock line

        config BTN_GPIO_RUN
            int "RUN Button GPIO"
            default 10
            help
                GPIO pin for RUN button (active low with pull-up)

        config BTN_GPIO_STOP
            int "STOP Button GPIO"
            default 11
            help
                GPIO pin for STOP button (active low with pull-up)

        config BTN_GPIO_ESTOP
            int "Emergency Stop GPIO"
            default 12
            help
                GPIO pin for emergency stop (NC contacts, active low)

        config LED_GPIO_RUNNING
            int "Running LED GPIO"
            default 17
            help
                GPIO pin for green running indicator LED

        config LED_GPIO_FAULT
            int "Fault LED GPIO"
            default 18
            help
                GPIO pin for red fault indicator LED

        config KEY_GPIO_1
            int "Keypad Key1 (▲) GPIO"
            default 1
            help
                GPIO pin for keypad key 1 (tension up / menu enter)

        config KEY_GPIO_2
            int "Keypad Key2 (▼) GPIO"
            default 2
            help
                GPIO pin for keypad key 2 (tension down / menu OK)

        config KEY_GPIO_3
            int "Keypad Key3 (◄) GPIO"
            default 6
            help
                GPIO pin for keypad key 3 (jog left / menu navigate)

        config KEY_GPIO_4
            int "Keypad Key4 (►) GPIO"
            default 7
            help
                GPIO pin for keypad key 4 (jog right / menu navigate)

        config LCD_I2C_ADDR
            hex "LCD I2C Address"
            default 0x27
            help
                I2C address of the PCF8574 LCD backpack (0x27 or 0x3F)
    endmenu

    menu "Encoder Configuration"
        config ENCODER_PPR
            int "Encoder Pulses Per Revolution"
            default 600
            help
                Number of pulses per revolution (before 4x quadrature multiplication)

        config ENCODER_FILTER_SIZE
            int "RPM Filter Window Size"
            default 5
            range 1 20
            help
                Moving average filter window size for RPM smoothing
    endmenu

    menu "Motor Configuration"
        config MOTOR_PWM_FREQ_HZ
            int "Motor PWM Frequency (Hz)"
            default 25000
            help
                PWM frequency for motor control (25kHz typical for silent operation)

        config MOTOR_MAX_RPM
            int "Maximum Motor RPM"
            default 2000
            help
                Maximum motor speed in RPM
    endmenu

    menu "Load Cell Configuration"
        config HX711_FILTER_SIZE
            int "HX711 Moving Average Window"
            default 20
            range 1 50
            help
                Moving average filter window size for raw load cell readings.
                Higher = smoother but slower response. Default: 20

        config HX711_EMA_ALPHA
            int "HX711 EMA Smoothing (1-100)"
            default 10
            range 1 100
            help
                Exponential Moving Average factor (value / 100).
                1 = very smooth (slow response), 100 = no smoothing (noisy).
                Recommended: 5-20 for tension control. Default: 10 (alpha=0.10)

        config HX711_SAMPLE_RATE_80HZ
            bool "Use 80Hz Sample Rate"
            default n
            help
                Use 80Hz instead of 10Hz sample rate (noisier but faster)
    endmenu

    menu "Control Loop Configuration"
        config TENSION_LOOP_FREQ_HZ
            int "Tension Loop Frequency (Hz)"
            default 10
            help
                Outer tension control loop update rate

        config SPEED_LOOP_FREQ_HZ
            int "Speed Loop Frequency (Hz)"
            default 50
            help
                Inner speed control loop update rate

        config SPEED_KP_DEFAULT
            int "Speed Loop Kp (x1000)"
            default 500
            help
                Default proportional gain for speed loop (divide by 1000)

        config SPEED_KI_DEFAULT
            int "Speed Loop Ki (x1000)"
            default 100
            help
                Default integral gain for speed loop (divide by 1000)

        config TENSION_KP_DEFAULT
            int "Tension Loop Kp (x1000)"
            default 200
            help
                Default proportional gain for tension loop (divide by 1000)

        config TENSION_KI_DEFAULT
            int "Tension Loop Ki (x1000)"
            default 50
            help
                Default integral gain for tension loop (divide by 1000)
    endmenu

    menu "Safety Limits"
        config SAFETY_MAX_TENSION_KG
            int "Maximum Tension (kg x10)"
            default 100
            help
                Maximum allowed tension in kg (x10, e.g., 100 = 10.0 kg)

        config SAFETY_MIN_TENSION_KG
            int "Minimum Tension (kg x10)"
            default 5
            help
                Minimum allowed tension in kg (x10, e.g., 5 = 0.5 kg)

        config SAFETY_MAX_RPM
            int "Maximum RPM Limit"
            default 2000
            help
                Maximum allowed motor RPM

        config SAFETY_STALL_TIMEOUT_MS
            int "Motor Stall Timeout (ms)"
            default 2000
            help
                Time before declaring motor stall fault
    endmenu

    menu "WiFi Configuration"
        config WIFI_SSID
            string "WiFi SSID (Station Mode)"
            default "TensionController"
            help
                SSID of WiFi network to connect to

        config WIFI_PASSWORD
            string "WiFi Password"
            default "tension123"
            help
                Password for WiFi network

        config WIFI_AP_SSID
            string "Access Point SSID"
            default "TensionAP"
            help
                SSID for ESP32 Access Point mode

        config WIFI_AP_PASSWORD
            string "Access Point Password"
            default "tension123"
            help
                Password for Access Point mode (min 8 chars)

        config WIFI_AP_MODE
            bool "Use Access Point Mode"
            default y
            help
                Start in Access Point mode instead of Station mode
    endmenu

    menu "LCD Configuration"
        config LCD_I2C_ADDRESS
            hex "LCD I2C Address"
            default 0x27
            help
                I2C address of PCF8574 LCD backpack (0x27 or 0x3F typical)

        config LCD_ROWS
            int "LCD Rows"
            default 4
            range 2 4
            help
                Number of LCD rows (2 or 4)

        config LCD_COLS
            int "LCD Columns"
            default 20
            range 16 20
            help
                Number of LCD columns (16 or 20)

        config LCD_BACKLIGHT_TIMEOUT_S
            int "Backlight Timeout (seconds)"
            default 60
            help
                Time before LCD backlight dims (0 = always on)
    endmenu

    menu "Data Logger Configuration"
        config LOGGER_BUFFER_SIZE
            int "Log Buffer Size (samples)"
            default 1000
            range 100 5000
            help
                Number of samples to keep in RAM circular buffer

        config LOGGER_RATE_HZ
            int "Logging Rate (Hz)"
            default 10
            range 1 100
            help
                Data logging update rate
    endmenu

    menu "Feature Enables"
        config ENABLE_WEB_INTERFACE
            bool "Enable Web Interface"
            default y
            help
                Enable HTTP server and web dashboard

        config ENABLE_LCD_INTERFACE
            bool "Enable LCD Interface"
            default y
            help
                Enable I2C LCD display and keypad

        config ENABLE_AUTO_TUNING
            bool "Enable Auto-Tuning"
            default y
            help
                Enable relay feedback auto-tuning feature

        config ENABLE_DATA_LOGGER
            bool "Enable Data Logger"
            default y
            help
                Enable data logging and metrics calculation
    endmenu

endmenu
```

## sdkconfig.defaults
```kconfig
# ESP32-S3 Tension Controller Default Configuration

# Target
CONFIG_IDF_TARGET="esp32s3"

# Flash Configuration
CONFIG_ESPTOOLPY_FLASHSIZE_4MB=y
CONFIG_ESPTOOLPY_FLASHMODE_QIO=y
CONFIG_ESPTOOLPY_FLASHFREQ_80M=y

# Partition Table
CONFIG_PARTITION_TABLE_CUSTOM=y
CONFIG_PARTITION_TABLE_CUSTOM_FILENAME="partitions.csv"

# FreeRTOS Configuration (Dual Core)
CONFIG_FREERTOS_UNICORE=n
CONFIG_FREERTOS_HZ=1000
CONFIG_FREERTOS_TIMER_TASK_STACK_DEPTH=3072
CONFIG_FREERTOS_USE_TRACE_FACILITY=y
CONFIG_FREERTOS_GENERATE_RUN_TIME_STATS=y

# Task Watchdog
CONFIG_ESP_TASK_WDT=y
CONFIG_ESP_TASK_WDT_TIMEOUT_S=10
CONFIG_ESP_TASK_WDT_CHECK_IDLE_TASK_CPU0=y
CONFIG_ESP_TASK_WDT_CHECK_IDLE_TASK_CPU1=y

# UART Console
CONFIG_ESP_CONSOLE_UART_DEFAULT=y
CONFIG_ESP_CONSOLE_UART_BAUDRATE=115200

# WiFi Configuration
CONFIG_ESP_WIFI_SOFTAP_ENABLED=y
CONFIG_ESP_WIFI_NVS_ENABLED=y
CONFIG_ESP_WIFI_SOFTAP_MAX_STA_CONN=4

# HTTP Server
CONFIG_HTTPD_MAX_REQ_HDR_LEN=1024
CONFIG_HTTPD_MAX_URI_LEN=512
CONFIG_HTTPD_WS_SUPPORT=y

# NVS Configuration
CONFIG_NVS_ENCRYPTION=n

# LEDC PWM
CONFIG_LEDC_TIMER_BIT_WIDTH=10

# I2C Configuration
CONFIG_I2C_MASTER_TIMEOUT_MS=1000

# Log Level
CONFIG_LOG_DEFAULT_LEVEL_INFO=y
CONFIG_LOG_MAXIMUM_LEVEL_DEBUG=y

# PCNT (Pulse Counter)
CONFIG_PCNT_CTRL_FUNC_IN_IRAM=y

# mDNS
CONFIG_MDNS_MAX_SERVICES=10

# Stack Size
CONFIG_ESP_MAIN_TASK_STACK_SIZE=8192
CONFIG_ESP_SYSTEM_EVENT_TASK_STACK_SIZE=4096

# Memory
CONFIG_ESP32S3_SPIRAM_SUPPORT=n
```
